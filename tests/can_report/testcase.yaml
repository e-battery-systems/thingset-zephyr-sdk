## tests/can_report/testcase.yaml
```yaml
# SPDX-License-Identifier: Apache-2.0

tests:
  thingset_sdk.can_report:
    integration_platforms:
      - native_posix_64
    extra_args: EXTRA_CFLAGS=-Werror
  thingset_sdk.can_report.isotp_fast:
    integration_platforms:
      - native_posix_64
    extra_args: EXTRA_CFLAGS=-Werror
    extra_configs:
      - CONFIG_ISOTP_FAST=y
      - CONFIG_ISOTP_USE_TX_BUF=y
```

## west.yml
```yaml
# Copyright (c) The ThingSet Project Contributors
# SPDX-License-Identifier: Apache-2.0

manifest:
  remotes:
    - name: zephyrproject
      url-base: https://github.com/zephyrproject-rtos
    - name: thingset
      url-base: https://github.com/e-battery-systems
    - name: libresolar
      url-base: https://github.com/LibreSolar
  projects:
    - name: zephyr
      remote: zephyrproject
      revision: v3.6-branch
      import:
        name-allowlist:
          - cmsis
          - edtt
          - hal_espressif
          - hal_nordic
          - hal_stm32
          - hal_st
          - loramac-node
          - mbedtls
          - mcuboot
          - picolibc
          - segger
          - tinycrypt
    - name: thingset-node-c
      remote: thingset
      revision: c22ea45e15bbf74aeac4219318dca7d8d8f186bb
      path: modules/thingset-node-c
      import: true
```
